/*
 * Copyright (c) 2022 The ZMK Contributors
 *
 * SPDX-License-Identifier: MIT
 */

#include <behaviors.dtsi>
#include <dt-bindings/zmk/keys.h>
#include <dt-bindings/zmk/bt.h>
#include <dt-bindings/zmk/rgb.h>
#include <dt-bindings/zmk/outputs.h>
#include <dt-bindings/zmk/ext_power.h>

#include "timing.h"
#include "accents.h"
#include "layers.h"
#include "punctuation_en.h"
#include "punctuation_hu.h"
#include "macros_whu.h"
#include "macros_wen.h"
#include "mhu.h"

// Left Side
#define TIL  3 // Top Index finger Left
#define TML  2
#define HIL 13 // Home Index Left
#define HML 12
#define HRL 11
#define HPL 10
#define BIL 23 // Bottom Index Left
#define BML 22
#define BRL 21
#define BPL 20
#define OTL 32 // Outer Thumb Left
#define ITL 31 // Inner Thumb Left

// Right Side
#define TIR  6 // Top Index finger Right
#define TMR  7
#define HIR 16 // Home Index Right
#define HMR 17
#define HRR 18
#define HPR 19
#define BIR 26 // Bottom Index Right
#define BMR 27
#define BRR 28
#define BPR 29
#define OTR 37 // Outer Thumb Right
#define ITR 38 // Inner Thumb Right

#define TAIPO_COMBO(NAME, HOST_LAYOUT, BINDINGS, OUTER_BINDINGS, INNER_BINDINGS, LEFT_KEYPOS, RIGHT_KEYPOS) \
combo_l_##NAME##HOST_LAYOUT { \
	timeout-ms = <TIMEOUT_MS>; \
	bindings = <BINDINGS>; \
	key-positions = <LEFT_KEYPOS>; \
	layers = <HOST_LAYOUT##_TAIPO>; \
}; \
combo_li_##NAME##HOST_LAYOUT { \
	timeout-ms = <TIMEOUT_MS>; \
	bindings = <INNER_BINDINGS>; \
	key-positions = <LEFT_KEYPOS ITL>; \
	layers = <HOST_LAYOUT##_TAIPO>; \
}; \
combo_lo_##NAME##HOST_LAYOUT { \
	timeout-ms = <TIMEOUT_MS>; \
	bindings = <OUTER_BINDINGS>; \
	key-positions = <LEFT_KEYPOS OTL>; \
	layers = <HOST_LAYOUT##_TAIPO>; \
}; \
combo_r_##NAME##HOST_LAYOUT { \
	timeout-ms = <TIMEOUT_MS>; \
	bindings = <BINDINGS>; \
	key-positions = <RIGHT_KEYPOS>; \
	layers = <HOST_LAYOUT##_TAIPO>; \
}; \
combo_ri_##NAME##HOST_LAYOUT { \
	timeout-ms = <TIMEOUT_MS>; \
	bindings = <INNER_BINDINGS>; \
	key-positions = <RIGHT_KEYPOS ITR>; \
	layers = <HOST_LAYOUT##_TAIPO>; \
}; \
combo_ro_##NAME##HOST_LAYOUT { \
	timeout-ms = <TIMEOUT_MS>; \
	bindings = <OUTER_BINDINGS>; \
	key-positions = <RIGHT_KEYPOS OTR>; \
	layers = <HOST_LAYOUT##_TAIPO>; \
};

/ {
    behaviors {
      skq: sticky_key_quick_release {
        compatible = "zmk,behavior-sticky-key";
        label = "STICKY_KEY_QUICK_RELEASE";
        #binding-cells = <1>;
        bindings = <&kp>;
        release-after-ms = <1000>;
        quick-release;
        ignore-modifiers;
      };
    };

    combos {
        compatible = "zmk,combos";

        combo_l_space { \
        	timeout-ms = <TIMEOUT_MS>; \
        	bindings = <&kp SPACE>; \
        	key-positions = <OTL>; \
        	layers = <WEN_TAIPO>; \
        };
        
        combo_r_space { \
        	timeout-ms = <TIMEOUT_MS>; \
        	bindings = <&kp SPACE>; \
        	key-positions = <OTR>; \
        	layers = <WEN_TAIPO>; \
        };
        
        combo_l_bspc { \
        	timeout-ms = <TIMEOUT_MS>; \
        	bindings = <&kp BSPC>; \
        	key-positions = <ITL>; \
        	layers = <WEN_TAIPO>; \
        };
        
        combo_r_bspc { \
        	timeout-ms = <TIMEOUT_MS>; \
        	bindings = <&kp BSPC>; \
        	key-positions = <ITR>; \
        	layers = <WEN_TAIPO>; \
        };

        TAIPO_COMBO(R,      WEN, &kp R, &kp GT,   &kp LS(R), HPL, HPR)
        TAIPO_COMBO(S,      WEN, &kp S, &kp RBRC, &kp LS(S), HRL, HRR)
        TAIPO_COMBO(N,      WEN, &kp N, &kp RBKT, &kp LS(N), HML, HMR)
        TAIPO_COMBO(I,      WEN, &kp I, &kp RPAR, &kp LS(I), HIL, HIR)
        TAIPO_COMBO(A,      WEN, &kp A, &kp LT,   &kp LS(A), BPL, BPR)
        TAIPO_COMBO(O,      WEN, &kp O, &kp LBRC, &kp LS(O), BRL, BRR)
        TAIPO_COMBO(T,      WEN, &kp T, &kp LBKT, &kp LS(T), BML, BMR)
        TAIPO_COMBO(E,      WEN, &kp E, &kp LPAR, &kp LS(E), BIL, BIR)
                               
        TAIPO_COMBO(B,      WEN, &kp B,     &kp N9,     &kp LS(B), HPL HRL, HPR HRR)
        TAIPO_COMBO(Y,      WEN, &kp Y,     &kp N5,     &kp LS(Y), HML HIL, HMR HIR)
        TAIPO_COMBO(L,      WEN, &kp L,     &kp N4,     &kp LS(L), BPL BRL, BPR BRR)
        TAIPO_COMBO(H,      WEN, &kp H,     &kp N0,     &kp LS(H), BML BIL, BMR BIR)
        TAIPO_COMBO(P,      WEN, &kp P,     &kp N7,     &kp LS(P), HRL HML, HRR HMR)
        TAIPO_COMBO(U,      WEN, &kp U,     &kp N2,     &kp LS(U), BRL BML, BRR BMR)
        TAIPO_COMBO(G,      WEN, &kp G,     &kp HASH,   &kp LS(G), HPL HIL, HPR HIR)
        TAIPO_COMBO(D,      WEN, &kp D,     &kp AT,     &kp LS(D), BPL BIL, BPR BIR)
        TAIPO_COMBO(Z,      WEN, &kp Z,     &kp N8,     &kp LS(Z), HPL HML, HPR HMR)
        TAIPO_COMBO(F,      WEN, &kp F,     &kp N6,     &kp LS(F), HRL HIL, HRR HIR)
        TAIPO_COMBO(Q,      WEN, &kp Q,     &kp N3,     &kp LS(Q), BPL BML, BPR BMR)        
        TAIPO_COMBO(C,      WEN, &kp C,     &kp N1,     &kp LS(C), BRL BIL, BRR BIR)
        TAIPO_COMBO(X,      WEN, &kp X,     &kp CARET,  &kp LS(X), HPL BML, HPR BMR)
        TAIPO_COMBO(K,      WEN, &kp K,     &kp PLUS,   &kp LS(K), HIL BRL, HIR BRR)
        TAIPO_COMBO(V,      WEN, &kp V,     &kp STAR,   &kp LS(V), HRL BIL, HRR BIR)
        TAIPO_COMBO(J,      WEN, &kp J,     &kp EQUAL,  &kp LS(J), HML BPL, HMR BPR)
        TAIPO_COMBO(M,      WEN, &kp M,     &kp DOLLAR, &kp LS(M), HPL BIL, HPR BIR)
        TAIPO_COMBO(W,      WEN, &kp W,     &kp AMPS,   &kp LS(W), HIL BPL, HIR BPR)
        TAIPO_COMBO(SLASH,  WEN, &kp SLASH, &kp PIPE,   &kp BSLH,  HRL BML, HRR BMR)
        TAIPO_COMBO(MINUS,  WEN, &kp MINUS, &kp PRCNT,  &kp UNDER, HML BRL, HMR BRR)
        TAIPO_COMBO(SEMI,   WEN, &kp SEMI,  &none,      &kp COLON, HPL BRL, HPR BRR)        
        TAIPO_COMBO(QMARK,  WEN, &kp QMARK, &none,      &kp EXCL,  HIL BML, HIR BMR)
        TAIPO_COMBO(COMMA,  WEN, &kp COMMA, &kp TILDE,  &kp DOT,   HML BIL, HMR BIR)
        TAIPO_COMBO(SQT,    WEN, &kp SQT,   &kp GRAVE,  &kp DQT,   HRL BPL, HRR BPR)
                               
        TAIPO_COMBO(LGUI,   WEN, &sk LGUI,   &kp PGUP, &kp RIGHT, HPL BPL, HPR BPR)
        TAIPO_COMBO(LALT,   WEN, &sk LALT,   &kp HOME, &kp UP,    HRL BRL, HRR BRR)
        TAIPO_COMBO(LSHIFT, WEN, &sk LSHIFT, &kp PGDN, &kp LEFT,  HIL BIL, HIR BIR)
        TAIPO_COMBO(LCTRL,  WEN, &sk LCTRL,  &kp END,  &kp DOWN,  HML BML, HMR BMR)
                                
        TAIPO_COMBO(TAB,    WEN, &kp TAB,   &kp INS,  &kp DEL, HRL HML HIL, HRR HMR HIR)
        TAIPO_COMBO(ENTER,  WEN, &kp ENTER, &kp LALT, &kp ESC, BRL BML BIL, BRR BMR BIR)
                                
        TAIPO_COMBO(TO_SYSTEM, WEN, &to SYSTEM, &none, &none, HPL HRL HML, HPR HRR HMR)
        
        TAIPO_COMBO(TO_SYSTEM, WHU, &to SYSTEM, &none, &none, HPL HRL HML, HPR HRR HMR)
        
        combo_shft_right {
            timeout-ms = <TIMEOUT_MS>;
            key-positions = <37 16>;
            bindings = <&skq LSHFT>;
            layers = <WEN_LAYER_SET WHU_LAYER_SET MHU_LAYER_SET>;
        };
        combo_shft_left {
            timeout-ms = <TIMEOUT_MS>;
            key-positions = <32 13>;
            bindings = <&skq LSHFT>;
            layers = <WEN_LAYER_SET WHU_LAYER_SET MHU_LAYER_SET>;
        };
        combo_ctrl_right {
            timeout-ms = <TIMEOUT_MS>;
            key-positions = <37 17>;
            bindings = <&skq LCTRL>;
            layers = <WEN_LAYER_SET WHU_LAYER_SET MHU_LAYER_SET>;
        };
        combo_ctrl_left {
            timeout-ms = <TIMEOUT_MS>;
            key-positions = <32 12>;
            bindings = <&skq LCTRL>;
            layers = <WEN_LAYER_SET WHU_LAYER_SET MHU_LAYER_SET>;
        };
        combo_alt_right {
            timeout-ms = <TIMEOUT_MS>;
            key-positions = <37 18>;
            bindings = <&skq LALT>;
            layers = <WEN_LAYER_SET WHU_LAYER_SET MHU_LAYER_SET>;
        };
        combo_alt_left {
            timeout-ms = <TIMEOUT_MS>;
            key-positions = <32 11>;
            bindings = <&skq LALT>;
            layers = <WEN_LAYER_SET WHU_LAYER_SET MHU_LAYER_SET>;
        }; 
        combo_gui_right {
            timeout-ms = <TIMEOUT_MS>;
            key-positions = <37 19>;
            bindings = <&skq LGUI>;
            layers = <WEN_LAYER_SET WHU_LAYER_SET MHU_LAYER_SET>;
        };
        combo_gui_left {
            timeout-ms = <TIMEOUT_MS>;
            key-positions = <32 10>;
            bindings = <&skq LGUI>;
            layers = <WEN_LAYER_SET WHU_LAYER_SET MHU_LAYER_SET>;
        };
        combo_globe_right {
            timeout-ms = <TIMEOUT_MS>;
            key-positions = <37 15>;
            bindings = <&skq GLOBE>;
            layers = <MHU_LAYER_SET>;
        };
        combo_globe_left {
            timeout-ms = <TIMEOUT_MS>;
            key-positions = <32 14>;
            bindings = <&skq GLOBE>;
            layers = <MHU_LAYER_SET>;
        };

        combo_to_wen_base_left {
            timeout-ms = <TIMEOUT_MS>;
            key-positions = <31 13>;
            bindings = <&to WEN_BASE>;
            layers = <WEN_LAYER_SET>;
        };
        combo_to_wen_base_right {
            timeout-ms = <TIMEOUT_MS>;
            key-positions = <38 16>;
            bindings = <&to WEN_BASE>;
            layers = <WEN_LAYER_SET>;
        };
        combo_to_wen_nav_left {
            timeout-ms = <TIMEOUT_MS>;
            key-positions = <31 12>;
            bindings = <&to WEN_NAV>;
            layers = <WEN_LAYER_SET>;
        };
        combo_to_wen_nav_right {
            timeout-ms = <TIMEOUT_MS>;
            key-positions = <38 17>;
            bindings = <&to WEN_NAV>;
            layers = <WEN_LAYER_SET>;
        };
        combo_to_wen_num_left {
            timeout-ms = <TIMEOUT_MS>;
            key-positions = <31 11>;
            bindings = <&to WEN_NUM>;
            layers = <WEN_LAYER_SET>;
        };
        combo_to_wen_num_right {
            timeout-ms = <TIMEOUT_MS>;
            key-positions = <38 18>;
            bindings = <&to WEN_NUM>;
            layers = <WEN_LAYER_SET>;
        };
        combo_to_wen_sym_left {
            timeout-ms = <TIMEOUT_MS>;
            key-positions = <31 10>;
            bindings = <&to WEN_SYM>;
            layers = <WEN_LAYER_SET>;
        };
        combo_to_wen_sym_right {
            timeout-ms = <TIMEOUT_MS>;
            key-positions = <38 19>;
            bindings = <&to WEN_SYM>;
            layers = <WEN_LAYER_SET>;
        };

        combo_to_wen_diaresis_left {
            timeout-ms = <TIMEOUT_MS>;
            key-positions = <31 23>;
            bindings = <&to WEN_DL>;
            layers = <WEN_LAYER_SET>;
        };
        combo_to_wen_diaresis_right {
            timeout-ms = <TIMEOUT_MS>;
            key-positions = <38 26>;
            bindings = <&to WEN_DL>;
            layers = <WEN_LAYER_SET>;
        };
        combo_to_wen_acute_left {
            timeout-ms = <TIMEOUT_MS>;
            key-positions = <31 22>;
            bindings = <&to WEN_AL>;
            layers = <WEN_LAYER_SET>;
        };
        combo_to_wen_acute_right {
            timeout-ms = <TIMEOUT_MS>;
            key-positions = <38 27>;
            bindings = <&to WEN_AL>;
            layers = <WEN_LAYER_SET>;
        };
        combo_to_wen_dacute_left {
            timeout-ms = <TIMEOUT_MS>;
            key-positions = <31 21>;
            bindings = <&to WEN_DAL>;
            layers = <WEN_LAYER_SET>;
        };
        combo_to_wen_dacute_right {
            timeout-ms = <TIMEOUT_MS>;
            key-positions = <38 28>;
            bindings = <&to WEN_DAL>;
            layers = <WEN_LAYER_SET>;
        };
        combo_to_wen_taipo_left {
            timeout-ms = <TIMEOUT_MS>;
            key-positions = <31 02>;
            bindings = <&to WEN_TAIPO>;
            layers = <WEN_LAYER_SET>;
        };
        combo_to_wen_taipo_right {
            timeout-ms = <TIMEOUT_MS>;
            key-positions = <38 07>;
            bindings = <&to WEN_TAIPO>;
            layers = <WEN_LAYER_SET>;
        };

        combo_to_whu_base_left {
            timeout-ms = <TIMEOUT_MS>;
            key-positions = <31 13>;
            bindings = <&to WHU_BASE>;
            layers = <WHU_LAYER_SET>;
        };
        combo_to_whu_base_right {
            timeout-ms = <TIMEOUT_MS>;
            key-positions = <38 16>;
            bindings = <&to WHU_BASE>;
            layers = <WHU_LAYER_SET>;
        };
        combo_to_whu_nav_left {
            timeout-ms = <TIMEOUT_MS>;
            key-positions = <31 12>;
            bindings = <&to WHU_NAV>;
            layers = <WHU_LAYER_SET>;
        };
        combo_to_whu_nav_right {
            timeout-ms = <TIMEOUT_MS>;
            key-positions = <38 17>;
            bindings = <&to WHU_NAV>;
            layers = <WHU_LAYER_SET>;
        };
        combo_to_whu_num_left {
            timeout-ms = <TIMEOUT_MS>;
            key-positions = <31 11>;
            bindings = <&to WHU_NUM>;
            layers = <WHU_LAYER_SET>;
        };
        combo_to_whu_num_right {
            timeout-ms = <TIMEOUT_MS>;
            key-positions = <38 18>;
            bindings = <&to WHU_NUM>;
            layers = <WHU_LAYER_SET>;
        };
        combo_to_whu_sym_left {
            timeout-ms = <TIMEOUT_MS>;
            key-positions = <31 10>;
            bindings = <&to WHU_SYM>;
            layers = <WHU_LAYER_SET>;
        };
        combo_to_whu_sym_right {
            timeout-ms = <TIMEOUT_MS>;
            key-positions = <38 19>;
            bindings = <&to WHU_SYM>;
            layers = <WHU_LAYER_SET>;
        };

        combo_to_whu_diaresis_left {
            timeout-ms = <TIMEOUT_MS>;
            key-positions = <31 23>;
            bindings = <&to WHU_DL>;
            layers = <WHU_LAYER_SET>;
        };
        combo_to_whu_diaresis_right {
            timeout-ms = <TIMEOUT_MS>;
            key-positions = <38 26>;
            bindings = <&to WHU_DL>;
            layers = <WHU_LAYER_SET>;
        };
        combo_to_whu_acute_left {
            timeout-ms = <TIMEOUT_MS>;
            key-positions = <31 22>;
            bindings = <&to WHU_AL>;
            layers = <WHU_LAYER_SET>;
        };
        combo_to_whu_acute_right {
            timeout-ms = <TIMEOUT_MS>;
            key-positions = <38 27>;
            bindings = <&to WHU_AL>;
            layers = <WHU_LAYER_SET>;
        };
        combo_to_whu_dacute_left {
            timeout-ms = <TIMEOUT_MS>;
            key-positions = <31 21>;
            bindings = <&to WHU_DAL>;
            layers = <WHU_LAYER_SET>;
        };
        combo_to_whu_dacute_right {
            timeout-ms = <TIMEOUT_MS>;
            key-positions = <38 28>;
            bindings = <&to WHU_DAL>;
            layers = <WHU_LAYER_SET>;
        };
        
        combo_enter_left {
            timeout-ms = <TIMEOUT_MS>;
            key-positions = <21 22 23>;
            bindings = <&kp RET>;
            layers = <WEN_LAYER_SET WHU_LAYER_SET MHU_LAYER_SET>;
        };
        combo_enter_right {
            timeout-ms = <TIMEOUT_MS>;
            key-positions = <26 27 28>;
            bindings = <&kp RET>;
            layers = <WEN_LAYER_SET WHU_LAYER_SET MHU_LAYER_SET>;
        };
        combo_tab_left {
            timeout-ms = <TIMEOUT_MS>;
            key-positions = <11 12 13>;
            bindings = <&kp TAB>;
            layers = <WEN_LAYER_SET WHU_LAYER_SET MHU_LAYER_SET>;
        };
        combo_tab_right {
            timeout-ms = <TIMEOUT_MS>;
            key-positions = <16 17 18>;
            bindings = <&kp TAB>;
            layers = <WEN_LAYER_SET WHU_LAYER_SET MHU_LAYER_SET>;
        };
        combo_esc_left {
            timeout-ms = <TIMEOUT_MS>;
            key-positions = <31 21 22 23>;
            bindings = <&kp ESC>;
            layers = <WEN_LAYER_SET WHU_LAYER_SET MHU_LAYER_SET>;
        };
        combo_esc_right {
            timeout-ms = <TIMEOUT_MS>;
            key-positions = <38 26 27 28>;
            bindings = <&kp ESC>;
            layers = <WEN_LAYER_SET WHU_LAYER_SET MHU_LAYER_SET>;
        };
        combo_del_left {
            timeout-ms = <TIMEOUT_MS>;
            key-positions = <31 11 12 13>;
            bindings = <&kp DEL>;
            layers = <WEN_LAYER_SET WHU_LAYER_SET MHU_LAYER_SET>;
        };
        combo_del_right {
            timeout-ms = <TIMEOUT_MS>;
            key-positions = <38 16 17 18>;
            bindings = <&kp DEL>;
            layers = <WEN_LAYER_SET WHU_LAYER_SET MHU_LAYER_SET>;
        };
    };

    keymap {
        compatible = "zmk,keymap";

        system_layer {
// SYSTEM
            bindings = <
    &none       &none        &none         &none          &none           &rgb_ug RGB_TOG  &rgb_ug RGB_EFF  &rgb_ug RGB_HUI  &rgb_ug RGB_SAI  &rgb_ug RGB_BRI
    &bt BT_CLR  &none        &to MHU_BASE  &to WHU_BASE   &none           &kp EP_TOG       &kp C_PREV       &kp C_VOL_DN     &kp C_VOL_UP     &kp C_NEXT
    &none       &none        &none         &to WEN_BASE   &none           &out OUT_TOG     &bt BT_SEL 0     &bt BT_SEL 1     &bt BT_SEL 2     &bt BT_SEL 3
    &kp N1      &key_repeat  &kp SPACE     &kp SEMI       &kp N2          &kp N3           &kp MINUS        &kp BSPC         &star_excl       &kp N4
            >;

            sensor-bindings = <&inc_dec_kp C_BRI_UP C_BRI_DN &inc_dec_kp C_VOL_DN C_VOL_UP >;
        };

        wen_base_layer {
// COLEMAK-DH
            bindings = <
    &kp Q   &kp W        &kp F      &kp P     &kp B           &kp J   &kp L      &kp U        &kp Y       &kp SQT
    &kp A   &kp R        &kp S      &kp T     &kp G           &kp M   &kp N      &kp E        &kp I       &kp O
    &kp Z   &kp X        &kp C      &kp D     &kp V           &kp K   &kp H      &comma_lpar  &dot_rpar   &kp FSLH
    &kp N1  &key_repeat  &kp SPACE  &kp SEMI  &kp N2          &kp N3  &kp MINUS  &kp BSPC     &star_excl  &kp N4
            >;

            sensor-bindings = <&inc_dec_kp C_BRI_UP C_BRI_DN &inc_dec_kp C_VOL_DN C_VOL_UP >;
        };

        wen_nav_layer {
// WEN_NAV
            bindings = <
    &to SYSTEM  &to WEN_TAIPO  &kp K_APP    &none         &kp KP_NUMLOCK          &kp INS       &none      &none      &none       &none
    &kp LGUI    &kp LALT       &kp LCTRL    &kp LSHFT     &caps_word              &kp CAPS      &kp LEFT   &kp DOWN   &kp UP      &kp RIGHT
    &m_undo     &m_cut_wen     &m_copy_wen  &m_paste_wen  &m_again_wen            &kp LC(BSPC)  &kp HOME   &kp PG_DN  &kp PG_UP   &kp END
    &kp N1      &key_repeat    &kp SPACE    &kp SEMI      &kp N2                  &kp N3        &kp MINUS  &kp BSPC   &star_excl  &kp N4
            >;

            sensor-bindings = <&inc_dec_kp C_BRI_UP C_BRI_DN &inc_dec_kp C_VOL_DN C_VOL_UP >;
        };

        wen_num_layer {
// WEN_NUM, KP_DOT would be better here instad of DOT, but num lock state interferes with KP_DOT.
            bindings = <
    &kp N6    &kp N7       &kp N8           &kp N9    &kp FSLH          &kp F12    &kp F9     &kp F8     &kp F7      &kp F6            
    &kp N0    &kp N1       &kp N2           &kp N3    &kp PLUS          &kp F11    &kp F3     &kp F2     &kp F1      &kp F10         
    &kp N4    &kp SLCK     &kp PAUSE_BREAK  &kp N5    &kp STAR          &kp PSCRN  &kp F5     &kp COMMA  &kp DOT     &kp F4       
    &kp N1    &key_repeat  &kp SPACE        &kp SEMI  &kp N2            &kp N3     &kp MINUS  &kp BSPC   &star_excl  &kp N4
            >;

            sensor-bindings = <&inc_dec_kp C_BRI_UP C_BRI_DN &inc_dec_kp C_VOL_DN C_VOL_UP >;
        };
        
        wen_sym_layer {
// WEN_SYM
            bindings = <
    &kp GRAVE  &kp LT       &kp GT     &kp DQT    &kp DOT            &kp AMPS   &m_scope   &kp LBKT  &kp RBKT    &kp PRCNT
    &kp EXCL   &kp MINUS    &kp PLUS   &kp EQUAL  &kp HASH           &kp PIPE   &kp COLON  &kp LPAR  &kp RPAR    &kp QMARK
    &kp CARET  &kp FSLH     &kp STAR   &kp BSLH   &m_par_dir         &kp TILDE  &kp DLLR   &kp LBRC  &kp RBRC    &kp AT
    &kp N1     &key_repeat  &kp SPACE  &kp SEMI   &kp N2             &kp N3     &kp MINUS  &kp BSPC  &star_excl  &kp N4
            >;

            sensor-bindings = <&inc_dec_kp C_BRI_UP C_BRI_DN &inc_dec_kp C_VOL_DN C_VOL_UP >;
        };

        wen_acute_layer {
// ACUTE LAYER
            bindings = <
    &to WEN_BASE     &to WEN_BASE  &to WEN_BASE  &to WEN_BASE  &to WEN_BASE           &to WEN_BASE  &to WEN_BASE  &u_acute_to_wen  &to WEN_BASE     &to WEN_BASE
    &a_acute_to_wen  &to WEN_BASE  &to WEN_BASE  &to WEN_BASE  &to WEN_BASE           &to WEN_BASE  &to WEN_BASE  &e_acute_to_wen  &i_acute_to_wen  &o_acute_to_wen
    &to WEN_BASE     &to WEN_BASE  &to WEN_BASE  &to WEN_BASE  &to WEN_BASE           &to WEN_BASE  &to WEN_BASE  &to WEN_BASE     &to WEN_BASE     &to WEN_BASE
    &to WEN_BASE     &to WEN_BASE  &to WEN_BASE  &to WEN_BASE  &to WEN_BASE           &to WEN_BASE  &to WEN_BASE  &to WEN_BASE     &to WEN_BASE     &to WEN_BASE
          >;

            sensor-bindings = <&inc_dec_kp C_BRI_UP C_BRI_DN &inc_dec_kp C_VOL_DN C_VOL_UP >;
        };

        wen_dacute_layer {
// DOUBLE ACUTE LAYER
            bindings = <
    &to WEN_BASE  &to WEN_BASE  &to WEN_BASE  &to WEN_BASE  &to WEN_BASE           &to WEN_BASE  &to WEN_BASE  &u_dacute_to_wen  &to WEN_BASE  &to WEN_BASE
    &to WEN_BASE  &to WEN_BASE  &to WEN_BASE  &to WEN_BASE  &to WEN_BASE           &to WEN_BASE  &to WEN_BASE  &to WEN_BASE      &to WEN_BASE  &o_dacute_to_wen
    &to WEN_BASE  &to WEN_BASE  &to WEN_BASE  &to WEN_BASE  &to WEN_BASE           &to WEN_BASE  &to WEN_BASE  &to WEN_BASE      &to WEN_BASE  &to WEN_BASE
    &to WEN_BASE  &to WEN_BASE  &to WEN_BASE  &to WEN_BASE  &to WEN_BASE           &to WEN_BASE  &to WEN_BASE  &to WEN_BASE      &to WEN_BASE  &to WEN_BASE
          >;

            sensor-bindings = <&inc_dec_kp C_BRI_UP C_BRI_DN &inc_dec_kp C_VOL_DN C_VOL_UP >;
        };

        wen_diaresis_layer {
// DIARESIS LAYER
            bindings = <
    &to WEN_BASE    &to WEN_BASE  &to WEN_BASE  &to WEN_BASE  &to WEN_BASE           &to WEN_BASE  &to WEN_BASE  &u_diaresis_to_wen  &to WEN_BASE  &to WEN_BASE
    &to WEN_BASE    &to WEN_BASE  &to WEN_BASE  &to WEN_BASE  &to WEN_BASE           &to WEN_BASE  &to WEN_BASE  &to WEN_BASE        &to WEN_BASE  &o_diaresis_to_wen
    &to WEN_BASE    &to WEN_BASE  &to WEN_BASE  &to WEN_BASE  &to WEN_BASE           &to WEN_BASE  &to WEN_BASE  &to WEN_BASE        &to WEN_BASE  &to WEN_BASE
    &to WEN_BASE    &to WEN_BASE  &to WEN_BASE  &to WEN_BASE  &to WEN_BASE           &to WEN_BASE  &to WEN_BASE  &to WEN_BASE        &to WEN_BASE  &to WEN_BASE
          >;

            sensor-bindings = <&inc_dec_kp C_BRI_UP C_BRI_DN &inc_dec_kp C_VOL_DN C_VOL_UP >;
        };

        wen_taipo_layer {
// TAIPO LAYER
            bindings = <
    &none    &none  &none  &none  &none           &none  &none  &none  &none  &none
    &none    &none  &none  &none  &none           &none  &none  &none  &none  &none
    &none    &none  &none  &none  &none           &none  &none  &none  &none  &none
    &none    &none  &none  &none  &none           &none  &none  &none  &none  &none
          >;

            sensor-bindings = <&inc_dec_kp C_BRI_UP C_BRI_DN &inc_dec_kp C_VOL_DN C_VOL_UP >;
        };

        whu_base_layer {
// COLEMAK-DH
            bindings = <
    &kp Q   &kp W        &kp F      &kp P            &kp B           &kp J   &kp L     &kp U            &kp Z           &sqt_dqt_whu
    &kp A   &kp R        &kp S      &kp T            &kp G           &kp M   &kp N     &kp E            &kp I           &kp O
    &kp Y   &kp X        &kp C      &kp D            &kp V           &kp K   &kp H     &comma_lpar_whu  &dot_rpar_whu   &fslh_qmark_whu
    &kp N1  &key_repeat  &kp SPACE  &semi_colon_whu  &kp N2          &kp N3  &kp FSLH  &kp BSPC         &star_excl_whu  &kp N4
            >;

            sensor-bindings = <&inc_dec_kp C_BRI_UP C_BRI_DN &inc_dec_kp C_VOL_DN C_VOL_UP >;
        };

        whu_nav_layer {
// WHU_NAV
            bindings = <
    &to SYSTEM  &to WHU_TAIPO  &kp K_APP    &none            &kp KP_NUMLOCK          &kp INS       &none             &none      &none           &none
    &kp LGUI    &kp LALT       &kp LCTRL    &kp LSHFT        &caps_word              &kp CAPS      &kp LEFT          &kp DOWN   &kp UP          &kp RIGHT
    &m_undo     &m_cut_whu     &m_copy_whu  &m_paste_whu     &m_again_whu            &kp LC(BSPC)  &kp HOME          &kp PG_DN  &kp PG_UP       &kp END
    &kp N1      &key_repeat    &kp SPACE    &semi_colon_whu  &kp N2                  &kp N3        &minus_under_whu  &kp BSPC   &star_excl_whu  &kp N4
            >;

            sensor-bindings = <&inc_dec_kp C_BRI_UP C_BRI_DN &inc_dec_kp C_VOL_DN C_VOL_UP >;
        };

        whu_num_layer {
// WHU_NUM, KP_DOT would be better here instad of DOT, but num lock state interferes with KP_DOT.
            bindings = <
    &kp N6     &kp N7       &kp N8           &kp N9           &kp CARET            &kp F12    &kp F9            &kp F8     &kp F7          &kp F6
    &kp GRAVE  &kp N1       &kp N2           &kp N3           &kp HASH             &kp F11    &kp F3            &kp F2     &kp F1          &kp F10
    &kp N4     &kp SLCK     &kp PAUSE_BREAK  &kp N5           &m_star_whu          &kp PSCRN  &kp F5            &kp COMMA  &kp DOT         &kp F4
    &kp N1     &key_repeat  &kp SPACE        &semi_colon_whu  &kp N2               &kp N3     &minus_under_whu  &kp BSPC   &star_excl_whu  &kp N4
            >;

            sensor-bindings = <&inc_dec_kp C_BRI_UP C_BRI_DN &inc_dec_kp C_VOL_DN C_VOL_UP >;
        };
        
        whu_sym_layer {
// WHU_SYM
            bindings = <
    &m_grave_whu          &m_lt_whu    &m_gt_whu    &m_dqt_whu     &kp DOT                 &m_amps_whu   &m_scope_whu      &m_lbkt_whu  &m_rbkt_whu     &m_prcnt_whu
    &m_excl_whu           &kp FSLH     &m_plus_whu  &m_equal_whu   &m_hash_whu             &m_pipe_whu   &m_colon_whu      &m_lpar_whu  &m_rpar_whu     &m_qmark_whu
    &carethulc_caret_whu  &m_fslh_whu  &m_star_whu  &m_bslh_whu    &m_par_dir_whu          &m_tilde_whu  &m_dllr_whu       &m_lbrc_whu  &m_rbrc_whu     &m_at_whu
    &kp N1                &key_repeat  &kp SPACE  &semi_colon_whu  &kp N2                  &kp N3        &minus_under_whu  &kp BSPC     &star_excl_whu  &kp N4
            >;

            sensor-bindings = <&inc_dec_kp C_BRI_UP C_BRI_DN &inc_dec_kp C_VOL_DN C_VOL_UP >;
        };

        whu_acute_layer {
// ACUTE LAYER
            bindings = <
    &to WHU_BASE       &to WHU_BASE  &to WHU_BASE  &to WHU_BASE  &to WHU_BASE           &to WHU_BASE  &to WHU_BASE  &m_u_acute_to_whu  &to WHU_BASE       &to WHU_BASE
    &m_a_acute_to_whu  &to WHU_BASE  &to WHU_BASE  &to WHU_BASE  &to WHU_BASE           &to WHU_BASE  &to WHU_BASE  &m_e_acute_to_whu  &m_i_acute_to_whu  &m_o_acute_to_whu
    &to WHU_BASE       &to WHU_BASE  &to WHU_BASE  &to WHU_BASE  &to WHU_BASE           &to WHU_BASE  &to WHU_BASE  &to WHU_BASE       &to WHU_BASE       &to WHU_BASE
    &to WHU_BASE       &to WHU_BASE  &to WHU_BASE  &to WHU_BASE  &to WHU_BASE           &to WHU_BASE  &to WHU_BASE  &to WHU_BASE       &to WHU_BASE       &to WHU_BASE
          >;

            sensor-bindings = <&inc_dec_kp C_BRI_UP C_BRI_DN &inc_dec_kp C_VOL_DN C_VOL_UP >;
        };

        whu_dacute_layer {
// DOUBLE ACUTE LAYER
            bindings = <
    &to WHU_BASE  &to WHU_BASE  &to WHU_BASE  &to WHU_BASE  &to WHU_BASE           &to WHU_BASE  &to WHU_BASE  &m_u_dacute_to_whu  &to WHU_BASE  &to WHU_BASE
    &to WHU_BASE  &to WHU_BASE  &to WHU_BASE  &to WHU_BASE  &to WHU_BASE           &to WHU_BASE  &to WHU_BASE  &to WHU_BASE        &to WHU_BASE  &m_o_dacute_to_whu
    &to WHU_BASE  &to WHU_BASE  &to WHU_BASE  &to WHU_BASE  &to WHU_BASE           &to WHU_BASE  &to WHU_BASE  &to WHU_BASE        &to WHU_BASE  &to WHU_BASE
    &to WHU_BASE  &to WHU_BASE  &to WHU_BASE  &to WHU_BASE  &to WHU_BASE           &to WHU_BASE  &to WHU_BASE  &to WHU_BASE        &to WHU_BASE  &to WHU_BASE
          >;

            sensor-bindings = <&inc_dec_kp C_BRI_UP C_BRI_DN &inc_dec_kp C_VOL_DN C_VOL_UP >;
        };

        whu_diaresis_layer {
// DIARESIS LAYER
            bindings = <
    &to WHU_BASE    &to WHU_BASE  &to WHU_BASE  &to WHU_BASE  &to WHU_BASE           &to WHU_BASE  &to WHU_BASE  &m_u_diaresis_to_whu  &to WHU_BASE  &to WHU_BASE
    &to WHU_BASE    &to WHU_BASE  &to WHU_BASE  &to WHU_BASE  &to WHU_BASE           &to WHU_BASE  &to WHU_BASE  &to WHU_BASE          &to WHU_BASE  &m_o_diaresis_to_whu
    &to WHU_BASE    &to WHU_BASE  &to WHU_BASE  &to WHU_BASE  &to WHU_BASE           &to WHU_BASE  &to WHU_BASE  &to WHU_BASE          &to WHU_BASE  &to WHU_BASE
    &to WHU_BASE    &to WHU_BASE  &to WHU_BASE  &to WHU_BASE  &to WHU_BASE           &to WHU_BASE  &to WHU_BASE  &to WHU_BASE          &to WHU_BASE  &to WHU_BASE
          >;

            sensor-bindings = <&inc_dec_kp C_BRI_UP C_BRI_DN &inc_dec_kp C_VOL_DN C_VOL_UP >;
        };

        whu_taipo_layer {
// TAIPO LAYER
            bindings = <
    &none    &none  &none  &none  &none           &none  &none  &none  &none  &none
    &none    &none  &none  &none  &none           &none  &none  &none  &none  &none
    &none    &none  &none  &none  &none           &none  &none  &none  &none  &none
    &none    &none  &none  &none  &none           &none  &none  &none  &none  &none
          >;

            sensor-bindings = <&inc_dec_kp C_BRI_UP C_BRI_DN &inc_dec_kp C_VOL_DN C_VOL_UP >;
        };

        mhu_base_layer {
// COLEMAK-DH
            bindings = <
    &kp Q   &kp W        &kp F      &kp P            &kp B           &kp J   &kp L             &kp U            &kp Z           &sqt_dqt_mhu
    &kp A   &kp R        &kp S      &kp T            &kp G           &kp M   &kp N             &kp E            &kp I           &kp O
    &kp Y   &kp X        &kp C      &kp D            &kp V           &kp K   &kp H             &comma_lpar_mhu  &dot_rpar_mhu   &fslh_qmark_mhu
    &kp N1  &key_repeat  &kp SPACE  &semi_colon_mhu  &kp N2          &kp N3  &minus_under_mhu  &kp BSPC         &star_excl_mhu  &kp N4
            >;

            sensor-bindings = <&inc_dec_kp C_BRI_UP C_BRI_DN &inc_dec_kp C_VOL_DN C_VOL_UP >;
        };

        mhu_nav_layer {
// MHU_NAV
            bindings = <
    &to SYSTEM   &to MHU_TAIPO  &kp K_APP    &none            &kp KP_NUMLOCK          &kp INS       &none             &none      &none           &none
    &kp LGUI     &kp LALT       &kp LCTRL    &kp LSHFT        &caps_word              &kp CAPS      &kp LEFT          &kp DOWN   &kp UP          &kp RIGHT
    &m_undo_mhu  &m_cut_mhu     &m_copy_mhu  &m_paste_mhu     &m_again_mhu            &kp LC(BSPC)  &kp HOME          &kp PG_DN  &kp PG_UP       &kp END
    &kp N1       &key_repeat    &kp SPACE    &semi_colon_mhu  &kp N2                  &kp N3        &minus_under_mhu  &kp BSPC   &star_excl_mhu  &kp N4
            >;

            sensor-bindings = <&inc_dec_kp C_BRI_UP C_BRI_DN &inc_dec_kp C_VOL_DN C_VOL_UP >;
        };

        mhu_num_layer {
// MHU_NUM, KP_DOT would be better here instad of DOT, but num lock state interferes with KP_DOT.
            bindings = <
    &kp N6     &kp N7       &kp N8           &kp N9           &kp CARET            &kp F12    &kp F9            &kp F8     &kp F7          &kp F6
    &kp GRAVE  &kp N1       &kp N2           &kp N3           &kp HASH             &kp F11    &kp F3            &kp F2     &kp F1          &kp F10
    &kp N4     &kp SLCK     &kp PAUSE_BREAK  &kp N5           &m_star_mhu          &kp PSCRN  &kp F5            &kp COMMA  &kp DOT         &kp F4
    &kp N1     &key_repeat  &kp SPACE        &semi_colon_mhu  &kp N2               &kp N3     &minus_under_mhu  &kp BSPC   &star_excl_mhu  &kp N4
            >;

            sensor-bindings = <&inc_dec_kp C_BRI_UP C_BRI_DN &inc_dec_kp C_VOL_DN C_VOL_UP >;
        };
        
        mhu_sym_layer {
// MHU_SYM
            bindings = <
    &m_grave_mhu  &m_lt_mhu    &m_gt_mhu    &m_dqt_mhu       &kp DOT                 &m_amps_mhu   &m_scope_mhu      &m_lbkt_mhu  &m_rbkt_mhu     &m_prcnt_mhu
    &m_excl_mhu   &kp FSLH     &m_plus_mhu  &m_equal_mhu     &m_hash_mhu             &m_pipe_mhu   &m_colon_mhu      &m_lpar_mhu  &m_rpar_mhu     &m_qmark_mhu
    &m_caret_mhu  &m_fslh_mhu  &m_star_mhu  &m_bslh_mhu      &m_par_dir_mhu          &m_tilde_mhu  &m_dllr_mhu       &m_lbrc_mhu  &m_rbrc_mhu     &m_at_mhu
    &kp N1        &key_repeat  &kp SPACE    &semi_colon_mhu  &kp N2                  &kp N3        &minus_under_mhu  &kp BSPC     &star_excl_mhu  &kp N4
            >;

            sensor-bindings = <&inc_dec_kp C_BRI_UP C_BRI_DN &inc_dec_kp C_VOL_DN C_VOL_UP >;
        };

        mhu_acute_layer {
// ACUTE LAYER
            bindings = <
    &to MHU_BASE       &to MHU_BASE  &to MHU_BASE  &to MHU_BASE  &to MHU_BASE           &to MHU_BASE  &to MHU_BASE  &m_u_acute_to_mhu  &to MHU_BASE       &to MHU_BASE
    &m_a_acute_to_mhu  &to MHU_BASE  &to MHU_BASE  &to MHU_BASE  &to MHU_BASE           &to MHU_BASE  &to MHU_BASE  &m_e_acute_to_mhu  &m_i_acute_to_mhu  &m_o_acute_to_mhu
    &to MHU_BASE       &to MHU_BASE  &to MHU_BASE  &to MHU_BASE  &to MHU_BASE           &to MHU_BASE  &to MHU_BASE  &to MHU_BASE       &to MHU_BASE       &to MHU_BASE
    &to MHU_BASE       &to MHU_BASE  &to MHU_BASE  &to MHU_BASE  &to MHU_BASE           &to MHU_BASE  &to MHU_BASE  &to MHU_BASE       &to MHU_BASE       &to MHU_BASE
          >;

            sensor-bindings = <&inc_dec_kp C_BRI_UP C_BRI_DN &inc_dec_kp C_VOL_DN C_VOL_UP >;
        };

        mhu_dacute_layer {
// DOUBLE ACUTE LAYER
            bindings = <
    &to MHU_BASE  &to MHU_BASE  &to MHU_BASE  &to MHU_BASE  &to MHU_BASE           &to MHU_BASE  &to MHU_BASE  &m_u_dacute_to_mhu  &to MHU_BASE  &to MHU_BASE
    &to MHU_BASE  &to MHU_BASE  &to MHU_BASE  &to MHU_BASE  &to MHU_BASE           &to MHU_BASE  &to MHU_BASE  &to MHU_BASE        &to MHU_BASE  &m_o_dacute_to_mhu
    &to MHU_BASE  &to MHU_BASE  &to MHU_BASE  &to MHU_BASE  &to MHU_BASE           &to MHU_BASE  &to MHU_BASE  &to MHU_BASE        &to MHU_BASE  &to MHU_BASE
    &to MHU_BASE  &to MHU_BASE  &to MHU_BASE  &to MHU_BASE  &to MHU_BASE           &to MHU_BASE  &to MHU_BASE  &to MHU_BASE        &to MHU_BASE  &to MHU_BASE
          >;

            sensor-bindings = <&inc_dec_kp C_BRI_UP C_BRI_DN &inc_dec_kp C_VOL_DN C_VOL_UP >;
        };

        mhu_diaresis_layer {
// DIARESIS LAYER
            bindings = <
    &to MHU_BASE    &to MHU_BASE  &to MHU_BASE  &to MHU_BASE  &to MHU_BASE           &to MHU_BASE  &to MHU_BASE  &m_u_diaresis_to_mhu  &to MHU_BASE  &to MHU_BASE
    &to MHU_BASE    &to MHU_BASE  &to MHU_BASE  &to MHU_BASE  &to MHU_BASE           &to MHU_BASE  &to MHU_BASE  &to MHU_BASE          &to MHU_BASE  &m_o_diaresis_to_mhu
    &to MHU_BASE    &to MHU_BASE  &to MHU_BASE  &to MHU_BASE  &to MHU_BASE           &to MHU_BASE  &to MHU_BASE  &to MHU_BASE          &to MHU_BASE  &to MHU_BASE
    &to MHU_BASE    &to MHU_BASE  &to MHU_BASE  &to MHU_BASE  &to MHU_BASE           &to MHU_BASE  &to MHU_BASE  &to MHU_BASE          &to MHU_BASE  &to MHU_BASE
          >;

            sensor-bindings = <&inc_dec_kp C_BRI_UP C_BRI_DN &inc_dec_kp C_VOL_DN C_VOL_UP >;
        };

        mhu_taipo_layer {
// TAIPO LAYER
            bindings = <
    &none    &none  &none  &none  &none           &none  &none  &none  &none  &none
    &none    &none  &none  &none  &none           &none  &none  &none  &none  &none
    &none    &none  &none  &none  &none           &none  &none  &none  &none  &none
    &none    &none  &none  &none  &none           &none  &none  &none  &none  &none
          >;

            sensor-bindings = <&inc_dec_kp C_BRI_UP C_BRI_DN &inc_dec_kp C_VOL_DN C_VOL_UP >;
        };

    };
};

